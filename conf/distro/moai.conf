## conf/distro/moai.conf
```bitbake
# inherit poky defaults
include conf/distro/poky.conf

# moai settings
DISTRO = "moai"
DISTRO_NAME = "moai distribution"
DISTRO_VERSION = "2020"

DISTRO_FEATURES_append = " \
  systemd \
  zeroconf \
"

DISTRO_FEATURES_remove = " \
  x11 \
  wayland \
  opengl \
  vulkan \
  gobject-introspection-data \
"

# enable systemd
DISTRO_FEATURES_BACKFILL_CONSIDERED = "sysvinit"
VIRTUAL-RUNTIME_init_manager = "systemd"
VIRTUAL-RUNTIME_initscripts = ""

TARGET_VENDOR = "-moai"
PACKAGE_CLASSES = "package_ipk"

GLIBC_GENERATE_LOCALES = "en_GB.UTF-8 en_US.UTF-8"
IMAGE_LINGUAS ?= "en-gb"

# default images
IMAGE_FSTYPES = "tar.bz2 wic.bz2 ext4.gz"
WKS_FILE = "sdimage-moai.wks"

# image Features
IMAGE_NAME = "${IMAGE_BASENAME}-${MACHINE}"

# default image config
IMAGE_HOSTNAME ?= "moai"

# raspberry pi specific
ENABLE_UART = "1"
RPI_USE_U_BOOT = "1"
KERNEL_IMAGETYPE = "uImage"

# accept Licenses
LICENSE_FLAGS_WHITELIST += "commercial"
ACCEPT_FSL_EULA = "1"

# remove kernel from boot
IMAGE_BOOT_FILES_remove = "${KERNEL_IMAGETYPE_UBOOT}"
```

## conf/layer.conf
```bitbake
# We have a conf and classes directory, add to BBPATH
BBPATH .= ":${LAYERDIR}"

# We have recipes-* directories, add to BBFILES
BBFILES += "${LAYERDIR}/recipes-*/*/*.bb ${LAYERDIR}/recipes-*/*/*.bbappend"

BBFILE_COLLECTIONS += "moai"
BBFILE_PATTERN_moai = "^${LAYERDIR}/"
BBFILE_PRIORITY_moai = "1"

# This should only be incremented on significant changes that will
# cause compatibility issues with other layers
LAYERVERSION_moai = "1"

LAYERDEPENDS_moai = "core"

LAYERSERIES_COMPAT_moai = "gatesgarth dunfell master"
```

## wic/sdimage-moai.wks
```
# short-description: Create Moai SD card image
# long-description: Creates a partitioned SD card image for use with moai
part /boot --source bootimg-partition --ondisk mmcblk0 --fstype=vfat --label boot --active --align 4096 --size 20
part / --size 4G --source rootfs --ondisk mmcblk0 --fstype=ext4 --label root --align 4096
part --size 4G --source rootfs --ondisk mmcblk0 --fstype=ext4 --label root2 --align 4096
part --size 4G --ondisk mmcblk0 --fstype=ext4 --label data --align 4096
```
